#include <PCM.h>

int whopressed = 0;       //1, 2 or 3 depending on the player who pressed the buzzer first

int buzz1 = 13;           //Buzzers for 3 players
int buzz2 = 12;
int buzz3 = 10;

int led1 = 9;             //LEDs to indicate the players turn
int led2 = 8;
int led3 = 7;
int qno = 1;                      //question number
int p1score = 0;                  //scores of players
int p2score = 0;
int p3score = 0;

int peizzo = 6;     //Buzzer to buzz


//The following 3 arrays are wave values. It is sent to the speaker. The speaker recognizes it and gives the output.

const unsigned char p1won[] PROGMEM = {      
 126, 126, 127, 126, 126, 127, 126, 126, 127, 127, 127, 128,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 141, 
 };
const unsigned char p2won[] PROGMEM = {
  125, 125, 127, 127, 127, 127, 127, 126, 125, 127, 128, 128,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 106, 
};
const unsigned char p3won[] PROGMEM = {
  126, 126, 126, 126, 126, 126, 127, 128, 128, 128, 129, 129,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 141, 
};



void setup() { 
  Serial.begin(9600);
  for(int i = 7; i < 11; i++) {
    pinMode(i, OUTPUT);
  }
  for(int i = 11; i < 14; i++){
    pinMode(i, INPUT);
  }
  pinMode(2,OUTPUT);
  pinMode(4,OUTPUT);
}

void ledIndicate()              //Glows the corresponding LED to indicate the player who pressed the buzzer first
{
  if(whopressed == 1){
    digitalWrite(led1, HIGH);
  }
  else if(whopressed == 2){
    digitalWrite(led2, HIGH);
  }
  else if(whopressed == 3){
    digitalWrite(led3, HIGH);
  } 
  delay(500);
}

void buzzer()                     //Sets the value of whopressed
{
  if(digitalRead(buzz1) == HIGH && whopressed == 0){
    whopressed = 1;
    tone(peizzo, 1500, 200);
    ledIndicate();
  }
  else if(digitalRead(buzz2) == HIGH && whopressed == 0){
    whopressed = 2;
    tone(peizzo, 1500, 200);
    ledIndicate();
  }
  else if(digitalRead(buzz3) == HIGH && whopressed == 0){
    whopressed = 3;
    tone(peizzo, 1500, 200);
    ledIndicate();
  }  
}



void loop() {
  while(whopressed == 0){
    buzzer();
  }
  if(whopressed != 0) {       
    Serial.write('1');                //Take voice input (control signal)
    int t = 0;
    while(t == 0) {
      int serialData = -1;
      if(Serial.available() > 0){       //Wait for response
        serialData = Serial.read();
        if(serialData == '1') {         //If correct answer, send appropriate control signal to second arduino
          if(whopressed == 1){
            digitalWrite(2, LOW);
            digitalWrite(4, HIGH);
            delay(1000);
            digitalWrite(2, LOW);
            digitalWrite(4, LOW);
            p1score++;
          }
          else if(whopressed == 2){
            digitalWrite(4, LOW);
            digitalWrite(2, HIGH);
            delay(1000);
            digitalWrite(2, LOW);
            digitalWrite(4, LOW);
            p2score++;
          }
          else if(whopressed == 3){
            digitalWrite(4, HIGH);
            digitalWrite(2, HIGH);
            delay(1000);
            digitalWrite(2, LOW);
            digitalWrite(4, LOW);
            p3score++;
          }
          delay(5000);
          t = 1;
        }
        else if(serialData == '0') {      //If wrong answer do nothing
          delay(5000);
          t = 1;
        }      
      }             
    }
  }
  if(whopressed != 0)                   //Reset the pins for next question 
  {
    whopressed = 0;
    for(int i = 7; i < 11; i++) {
      digitalWrite(i, LOW);
    }
  }
  if(qno == 6){                         //If it is last question, declare the winner through speaker and end the quiz
    if(p1score > p2score){
      if(p1score > p3score){
        startPlayback(p1won, sizeof(p1won));
      }
      else{
        startPlayback(p3won, sizeof(p3won));
      }
    }
    else if (p2score > p3score) {
        startPlayback(p2won, sizeof(p2won));
    }
    else{
        startPlayback(p3won, sizeof(p3won));
    }
    delay(2000);
    exit(0);
  }
  qno++;
}
